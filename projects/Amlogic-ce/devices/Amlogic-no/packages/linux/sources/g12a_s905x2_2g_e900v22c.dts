/* SPDX-License-Identifier: (GPL-2.0+ OR MIT) */
/*
 * Skyworth E900V22C (Amlogic S905L3A / G12A)
 *
 * 以「已实机验证可开机」的通用 g12a_s905x2_2g 为基底(它本身也是 include 组合)，
 * 只补上 UWE5621DS 的 SDIO wifi 子节点。
 *
 * 为何需要这个节点: uwe5631-aml 套件的 udev 规则(80-unisoc_sdio.rules)要
 *   OF_NAME=="wifi" + OF_COMPATIBLE_0=="sprd,unisoc-wifi"
 * 才会 kmod load sprdwl_ng/sprdbt_tty 并拉起 sprd_sdio-firmware-aml.service
 * (该 service 负责 rfkill unblock + hciattach sprd)。缺这个节点时，SDIO 装置
 * (实机 mmc2:8800:1, SDIO_ID 0000:0000)关联不到任何 DT 节点，uevent 里没有
 * OF_NAME/OF_COMPATIBLE，规则永远不匹配 → 开机三个模块一个都不载入。
 * 驱动本身靠 SDIO ID 绑定，所以手动 insmod 一切正常 —— 那是两回事，别混淆。
 *
 * 写法照上游官方两块 Unisoc 板: s4_s905y4_buzztv_hd5_2g.dts /
 * sc2_s905x4_buzztv_x5_2g.dts。差别是它们挂 sd_emmc_a，本机挂 sd_emmc_b2
 * (ffe05000)：实机 SDIO 就在 ffe05000.sd2，且 G12A 的 SDIO DMA erratum 专属
 * ffe03000 那颗，CoreELEC 正是靠避开它才跑得了 DDR DMA。
 */

#include "g12a_s905x2_2g.dts"

/{
	model = "Skyworth E900V22C";
	coreelec-dt-id = "g12a_s905x2_2g_e900v22c";
};

&sd_emmc_b2 {
	wifi@1 {
		compatible = "sprd,unisoc-wifi";
		reg = <1>;
	};
};
